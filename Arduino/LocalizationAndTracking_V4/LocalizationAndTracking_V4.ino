// """
// Assignment Title: Localization and tracking of moving targets by hydrophones
// Purpose         : Implementation a sound triangulation system using three hydrophones to locate the source of a sound. 
//                   The code defines the pins for each hydrophone and their positions in space, then initializes the serial 
//                   communication and sets the pins as input. In the loop, the code reads the analog values from each hydrophone, 
//                   calculates the time delay between them, and then the time difference of arrival (TDOA) for each pair of 
//                   hydrophones. Using triangulation, the code then calculates the x and y coordinates of the sound source and 
//                   prints them to the serial monitor. Calculate the distance between the sound source and each hydrophone using 
//                   the Pythagorean theorem.
// Language        : Arduino and Matlab
// Author          : Hemant Ramphul
// Github          : https://github.com/hemantramphul/Localization-and-tracking-of-moving-targets-by-hydrophones/
// Date            : 05 May 2023

// Université des Mascareignes (UdM)
// Faculty of Information and Communication Technology
// Master Artificial Intelligence and Robotics
// Official Website: https://udm.ac.mu
// """
#include <SPI.h>
#include <Wire.h>
#include <Adafruit_GFX.h>
#include <Adafruit_SSD1306.h>

#define SCREEN_WIDTH 128 // OLED display width, in pixels
#define SCREEN_HEIGHT 64 // OLED display height, in pixels

// Declaration for an SSD1306 display connected to I2C (SDA, SCL pins)
// The pins for I2C are defined by the Wire-library. 
// On an arduino UNO:       A4(SDA), A5(SCL)
// On an arduino MEGA 2560: 20(SDA), 21(SCL)
// On an arduino LEONARDO:   2(SDA),  3(SCL), ...
#define OLED_RESET     -1 // Reset pin # (or -1 if sharing Arduino reset pin)
#define SCREEN_ADDRESS 0x3C ///< See datasheet for Address; 0x3D for 128x64, 0x3C for 128x32
Adafruit_SSD1306 display(SCREEN_WIDTH, SCREEN_HEIGHT, &Wire, OLED_RESET);

static const unsigned char PROGMEM university[] = {
  0xff, 0xff, 0xff, 0xff, 0xff, 0xff, 0xff, 0xff, 0xff, 0xff, 0xff, 0xff, 0xff, 0xff, 0xff, 0xff, 
  0xff, 0xff, 0xff, 0xff, 0xff, 0xff, 0xff, 0xff, 0xff, 0xff, 0xff, 0xff, 0xff, 0xff, 0xff, 0xff, 
  0xff, 0xff, 0xff, 0xff, 0xff, 0xff, 0xff, 0xff, 0xff, 0xff, 0xff, 0xff, 0xff, 0xff, 0xff, 0xff, 
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  0xff, 0xff, 0xff, 0xff, 0xff, 0xff, 0xff, 0xff, 0xff, 0xff, 0xff, 0xff, 0xff, 0xff, 0xff, 0xff
};

const int hydrophone1 = A0; // Hydrophone 1 connected to analog pin A0
const int hydrophone2 = A1; // Hydrophone 2 connected to analog pin A1
const int hydrophone3 = A2; // Hydrophone 3 connected to analog pin A2
int LED1 = 8; 
int LED2 = 9;
int LED3 = 10;
int LED_ONOFF = 11; // System ON/OFF

const float soundSpeed = 343.0; // Speed of sound in m/s

const float positions[3][2] = {
  {0.0, 0.0}, // Hydrophone 1 position (x, y) in meters
  {0.25, 0.0}, // Hydrophone 2 position (x, y) in meters
  {0.0, 0.25} // Hydrophone 3 position (x, y) in meters
};

// Declare the calculateDelay function for three hydrophones
int calculateDelay() {
  // Find the time at which hydrophone1's waveform crosses a threshold
  int threshold = 640; // Adjust this value as needed
  int time1 = 0;
  while (analogRead(hydrophone1) < threshold) {
    time1++;
    delay(100);
  }

  // Find the time at which hydrophone2's waveform crosses the same threshold
  int time2 = 0;
  while (analogRead(hydrophone2) < threshold) {
    time2++;
    delay(100);
  }

  // Find the time at which hydrophone3's waveform crosses the same threshold
  int time3 = 0;
  while (analogRead(hydrophone3) < threshold) {
    time3++;
    delay(100);
  }

  // Return the time differences between the waveforms
  int delay12 = time2 - time1;
  int delay13 = time3 - time1;
  
  return delay12, delay13;
}

// Calculate the distance between a hydrophone and the sound source
float calculateDistance(int micIndex, float x, float y, const float positions[][2]) {
  float dx = x - positions[micIndex][0];
  float dy = y - positions[micIndex][1];
  return sqrt(dx * dx + dy * dy);
}

void handleLeds(int mic) {
  if (mic == 1) {
    digitalWrite(LED1, HIGH);
  }
  else if (mic == 2) {
    digitalWrite(LED2, HIGH);
  }
  else if (mic == 3) {
    digitalWrite(LED3, HIGH);
  }

  // Wait for 100ms before taking another measurement
  delay(1000);

  digitalWrite(LED1, LOW);
  digitalWrite(LED2, LOW);
  digitalWrite(LED3, LOW);
}

void setup() {
  Serial.begin(9600);
  
   
  if(!display.begin(SSD1306_SWITCHCAPVCC, 0x3C)) {
    Serial.println(F("SSD1306 allocation failed"));
    for(;;);
  }
  delay(2000); // Pause for 2 seconds
 
  // Clear the buffer.
  display.clearDisplay();
  
  // Draw bitmap on the screen
  display.drawBitmap(0, 0, university, 128, 64, 1);
  display.display();
  delay(4000); // Pause for 4 seconds

  // Draw bitmap on the screen
  display.clearDisplay();
  display.setTextSize(1);
  display.setTextColor(WHITE);
  display.setCursor(10,20);
  display.println("Sound Localization");
  display.setCursor(20,35);
  display.println("Hemant Ramphul");  
  display.display();

  pinMode(LED1, OUTPUT);
  pinMode(LED2, OUTPUT);
  pinMode(LED3, OUTPUT);
  pinMode(LED_ONOFF, OUTPUT);
  
  pinMode(hydrophone1, INPUT);
  pinMode(hydrophone2, INPUT);
  pinMode(hydrophone3, INPUT);

  // Turn system ON/OFF
  digitalWrite(LED_ONOFF, HIGH);
}

// Display function 
void displaySPI(int hydro, float x, float y) {
  display.setTextSize(1);
  display.setTextColor(WHITE);
  delay(2000);
  display.clearDisplay();
    // Print the nearest hydrophone [NH]
    
  display.setCursor(35, 0);
  display.println("Hydrophone");
  display.setTextSize(3);
  display.setCursor(55, 15);
  display.println(hydro + 1);
  // Print the x and y coordinates of the sound source
  display.setTextSize(1);
  display.setCursor(5, 55);
  display.print("(x = ");
  display.print(x);
  display.print(", y = ");
  display.print(y);
  display.println(")");
  display.display();
}

void loop() {
  // Call the calculateDelay function and assign the return values to variables
  int delay12, delay13;
  delay12, delay13 = calculateDelay();

  // Calculate the time difference of arrival (TDOA) between hydrophones
  float tdoa12 = (float)delay12 / 1000000.0 * soundSpeed;
  float tdoa13 = (float)delay13 / 1000000.0 * soundSpeed;

  // Calculate the x and y coordinates of the sound source using triangulation
  float x = ((positions[0][0] - positions[1][0]) * (positions[0][0] + positions[1][0] + 2.0 * tdoa12) - (positions[0][0] - positions[2][0]) * (positions[0][0] + positions[2][0] + 2.0 * tdoa13)) / (4.0 * (positions[0][1] - positions[1][1]) * (positions[0][0] - positions[2][0]) - 4.0 * (positions[0][1] - positions[2][1]) * (positions[0][0] - positions[1][0]));
  float y = ((positions[0][1] - positions[1][1]) * (positions[0][1] + positions[1][1] + 2.0 * tdoa12) - (positions[0][1] - positions[2][1]) * (positions[0][1] + positions[2][1] + 2.0 * tdoa13)) / (4.0 * (positions[0][0] - positions[1][0]) * (positions[0][1] - positions[2][1]) - 4.0 * (positions[0][0] - positions[2][0]) * (positions[0][1] - positions[1][1]));

  // Calculate the distance between the sound source and each hydrophone
  float distances[3];
  for (int i = 0; i < 3; i++) {
    distances[i] = calculateDistance(i, x, y, positions);
  }

  // Determine the nearest hydrophone
  int nearestHydro = 0;
  float shortestDistance = distances[0];
  for (int i = 1; i < 3; i++) {
    if (distances[i] < shortestDistance) {
      shortestDistance = distances[i];
      nearestHydro = i;
    }
  }

  // Display on LCD
  displaySPI (nearestHydro, x, y);

  // Print the nearest hydrophone
  Serial.print(nearestHydro + 1);
  Serial.print(" NH; x = ");
  // Print the x and y coordinates of the sound source
  Serial.print(x);
  Serial.print(", y = ");
  Serial.println(y);

  // Turn on the led for the coresponding hydrophone 
  handleLeds(nearestHydro + 1);
}